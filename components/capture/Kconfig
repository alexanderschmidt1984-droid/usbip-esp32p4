## components/capture/Kconfig
```kconfig
menu "Packet Capture"
    config CAPTURE_ENABLED
        bool "Enable packet capture support"
        default n
        help
            Records USB/IP traffic to an SD card (PCAP). Disabled by default because
            it captures everything, including security-key (FIDO/OTP) traffic.
    config CAPTURE_RING_BUF_SIZE
        int "Ring buffer size (bytes)"
        default 1048576
        depends on CAPTURE_ENABLED
    config CAPTURE_SNAPLEN
        int "Max payload bytes per packet"
        default 256
        depends on CAPTURE_ENABLED
endmenu
```

## main/Kconfig.projbuild
```kconfig
menu "USB/IP Server Configuration"

    config USBIP_TCP_PORT
        int "USB/IP TCP port"
        default 3240
        help
            TCP port number for the USB/IP server to listen on.

    config USBIP_MAX_DEVICES
        int "Maximum number of USB devices"
        default 8
        help
            Maximum number of USB devices that can be exported.

    config USBIP_MAX_CLIENTS
        int "Maximum number of concurrent clients"
        default 4
        help
            Maximum number of concurrent USB/IP client connections.

    config USBIP_HOSTNAME
        string "mDNS hostname"
        default "usbip-esp32p4"
        help
            Hostname used for mDNS advertisement.

    config USBIP_DEVICE_ALLOWLIST
        string "Default USB device allowlist (VID:PID)"
        default ""
        help
            Comma-separated list of USB devices that may be exported, as
            hexadecimal VID:PID pairs. "*" matches any PID of a vendor, e.g.
            "1050:*" for all Yubico keys or "1050:0407,0403:6001".
            Empty = every device is exported (original behaviour).
            This is only the factory default: the list can be changed at
            runtime in the Web UI (Settings -> Device Filter) and is then
            stored in NVS.

    config USBIP_WEBUI_REQUIRE_PASSWORD
        bool "Require a Web UI password before settings can be changed"
        default y
        help
            Secure default: as long as no Web UI password is configured, every
            state-changing request (ACL, network, device filter, export,
            capture, factory reset, ...) is refused, except setting the
            password itself. Read-only pages stay available.

    config USBIP_POWER_SAVE
        bool "Power save: dynamic CPU frequency scaling"
        depends on PM_ENABLE
        default y
        help
            Lets the CPU clock down while no USB/IP device is attached. A
            power-management lock keeps the CPU at full speed for as long as a
            device is attached, so transfer latency is unaffected. Light sleep
            is NOT used (the board must stay reachable on the network).
            Compiled in = offered in the web UI (Settings -> System), on by
            default; switching it off there keeps the CPU at full clock.
            Note: the Ethernet driver holds an APB_FREQ_MAX lock, so the idle
            clock is 100 MHz on ESP32-P4, not USBIP_PM_MIN_FREQ_MHZ.

    config USBIP_PM_MIN_FREQ_MHZ
        int "Minimum CPU frequency when idle (MHz)"
        depends on USBIP_POWER_SAVE
        default 40
        help
            CPU frequency used while idle. 40 MHz = crystal frequency.

    config USBIP_WIREGUARD
        bool "WireGuard tunnel support"
        default y
        help
            Compiles in an outbound WireGuard tunnel (esphome/wireguard). It is
            configured and switched on/off in the web UI (Settings -> WireGuard)
            and is off until enabled there.

    config USBIP_WG_NTP_SERVER
        string "NTP server for WireGuard"
        depends on USBIP_WIREGUARD
        default "pool.ntp.org"
        help
            WireGuard handshakes need correct wall-clock time; it is fetched via
            SNTP from this server before the tunnel starts.

    config USBIP_TLS_PORT
        int "USB/IP over TLS port"
        default 3241
        help
            TCP port of the TLS-PSK proxy for USB/IP. Enabled and switched
            (off / additional / TLS only) in the web UI. The PC side uses stunnel.

endmenu
```
